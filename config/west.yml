## config/west.yml
```yaml
manifest:
  remotes:
    - name: zmkfirmware
      url-base: https://github.com/zmkfirmware
    - name: manuellovell
      url-base: https://github.com/ManuelLovell

  projects:
    - name: zmk
      remote: zmkfirmware
      revision: main
      import: app/west.yml
    - name: zmk-pmw3610-driver
      remote: manuellovell
      revision: main  # change this if you're using a branch like "y-fix"

  self:
    path: config
```
